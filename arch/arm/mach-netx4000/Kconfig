## arch/arm/mach-netx4000/Kconfig
```kconfig
config NETX4000
	bool "Hilscher netX4000 SoC support"
	depends on ARCH_NETX4000
	select CPU_V7A

menu "netX4000 Boards"

choice
	prompt "netX4000 board select"

config TARGET_NXHX4000_REV4
	bool "NXHX4000-JTAG+ Rev.4"
	help
	  NXHX4000-JTAG+ Rev. 4 board
	select NETX4000
endchoice

choice
	prompt "DDR RAM Type"

config DDR_RAM_AS4C512M16D3L_12_2GIB
	bool "2GiB (AS4C512M16D3L-12)"

config DDR_RAM_IS43TR16256AL_1GIB
	bool "1GiB (IS43TR16256A)"

config DDR_RAM_OUT_OF_TREE
	bool "Out of tree DDR RAM parameters."
        help
	  Select this to provide your own specific DDR RAM timing parameters.

endchoice

config DDR_RAM_OUT_OF_TREE_INCLUDE_400
	string "Include file for out of tree DDR RAM parameters (400MHz)."
	default "mach/as4c512m16d3l-12-2gib-400mhz.h"
	depends on DDR_RAM_OUT_OF_TREE

config DDR_RAM_OUT_OF_TREE_INCLUDE_600
	string "Include file for out of tree DDR RAM parameters (600MHz)."
	default "mach/as4c512m16d3l-12-2gib-600mhz"
	depends on DDR_RAM_OUT_OF_TREE

config DDR400_RAM_INCLUDE
	string
	default "mach/as4c512m16d3l-12-2gib-400mhz.h" if DDR_RAM_AS4C512M16D3L_12_2GIB
	default "mach/is43tr16256al-1gib-400mhz.h" if DDR_RAM_IS43TR16256AL_1GIB
	default DDR_RAM_OUT_OF_TREE_INCLUDE_400 if DDR_RAM_OUT_OF_TREE

config DDR600_RAM_INCLUDE
	string
	default "mach/as4c512m16d3l-12-2gib-600mhz.h" if DDR_RAM_AS4C512M16D3L_12_2GIB
	default "mach/is43tr16256al-1gib-600mhz.h" if DDR_RAM_IS43TR16256AL_1GIB
	default DDR_RAM_OUT_OF_TREE_INCLUDE_600 if DDR_RAM_OUT_OF_TREE

config ENABLE_DDR_ECC
	bool "Enable ecc for DDR-RAM"
	default n
	help
	  Enables ecc for DDR-RAM.
	  NOTE: This feature will slow down the boot process due to the memory initialization time.

endmenu

config FDL_ADDRESS
	hex "Memory location of flash device label"
	default "0x0505f000"
	help
	  Setup memory location where to find a flash device label containing device data like MAC
	  address and board information.

config SYS_BOARD
	default "netx4000"

config SYS_VENDOR
	default "hilscher"

config SYS_SOC
	default "netx4000"

config SYS_CONFIG_NAME
	default "netx4000"
```

## configs/netx4000_defconfig
```kconfig
CONFIG_ARM=y
CONFIG_ARCH_NETX4000=y
CONFIG_SYS_THUMB_BUILD=y
CONFIG_SYS_TEXT_BASE=0x05000000
CONFIG_SYS_MALLOC_F_LEN=0x2000
CONFIG_FIT=y
CONFIG_HUSH_PARSER=y
CONFIG_DOS_PARTITION=y
CONFIG_CMD_EXT2=y
CONFIG_CMD_EXT4=y
CONFIG_CMD_EXT4_WRITE=y
CONFIG_CMD_FAT=y
CONFIG_CMD_CACHE=y
CONFIG_CMD_MMC=y
CONFIG_OF_CONTROL=y
CONFIG_OF_SEPARATE=y
CONFIG_DEFAULT_DEVICE_TREE="netx4000-nxhx4000-jtag-plus-rev4"
CONFIG_DM_MMC=y
CONFIG_DM_ETH=y
CONFIG_PINCTRL=y
CONFIG_FS_FAT=y

CONFIG_USB=y
CONFIG_USB_EHCI_HCD=y
CONFIG_USB_EHCI_NETX4000=y
CONFIG_USB_STORAGE=y
CONFIG_CMD_USB=y

CONFIG_CMD_SF=y
CONFIG_CMD_SPI=y
CONFIG_SPI=y
CONFIG_DM_SPI=y
CONFIG_DM_SPI_FLASH=y
CONFIG_SPI_FLASH=y
CONFIG_SPI_FLASH_MACRONIX=y
CONFIG_SPI_FLASH_WINBOND=y
CONFIG_SPI_FLASH_USE_4K_SECTORS=y
CONFIG_SPI_FLASH_MTD=y
CONFIG_NETX4000_QSPI=y

# CONFIG_CMD_BOOTEFI is not set
# CONFIG_CMD_BOOTEFI_HELLO_COMPILE is not set
# CONFIG_EFI_LOADER is not set
# CONFIG_EFI_UNICODE_CAPITALIZATION is not set
```
